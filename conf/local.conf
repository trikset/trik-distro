## conf/local.conf
```bitbake
# CONF_VERSION is increased each time build/conf/ changes incompatibly
CONF_VERSION = "2"

INHERIT += "rm_work"
INHERIT += "buildhistory"
BUILDHISTORY_COMMIT = "1"

# Uncomment and install corresponding packages manually to speedup build
#ASSUME_PROVIDED += "qemu-native libsdl-native \
#                    subversion-native gettext-native unzip-native lzop-native\
#                    cmake-native mono-native"
#SANITY_REQUIRED_UTILITIES += "mono mcs qemu-arm lzop svn git unzip cmake"

#PACKAGECONFIG_pn-qemu-native = "sdl"
# Which files do we want to parse:
#BBMASK = "meta-ros/recipes-extended/wxwidgets|meta-ros/recipes-support/boost|"
#BBMASK = "meta/recipes-core/jpeg/"

# What kind of additional images do we want?
# default is sdimg.xz, but ext4, ext4.xz and uncompressed sdimg are possible
IMAGE_FSTYPES = ""

# Remove old image file (to save space) before new one is created.
RM_OLD_IMAGE="1"
ERROR_QA:remove = "version-going-backwards"
# Make use of SMP:
#   PARALLEL_MAKE specifies how many concurrent compiler threads are spawned per bitbake process
#   BB_NUMBER_THREADS specifies how many concurrent bitbake tasks will be run
PARALLEL_MAKE     = "-j8"
BB_NUMBER_THREADS = "8"
GCCVERSION = "arm-11.%"
DISTRO = ""
DISTRO_FEATURES = "${DISTRO_FEATURES_DEFAULT} ${DISTRO_FEATURES_LIBC} smbfs zeroconf pam directfb x11"
#DISTRO_FEATURES_remove += "x11"
#DISTRO_FEATURES += "ld-is-gold"
#SELECTED_OPTIMIZATION = "-Os"

# classic way to extend image
#CORE_IMAGE_EXTRA_INSTALL += "mono fsharp"
#preferred way to add packages 
#IMAGE_INSTALL_append = " mono fsharp"

# Set DEPLOY_DIR outside of TMPDIR

PACKAGE_CLASSES = "package_ipk"
SDKMACHINE ??= "x86_64"
SDK_NAME_PREFIX = "trik-sdk"
SDKPATH = "/opt/${SDK_NAME_PREFIX}"


MAX_ATOMIC_WIDTH[arm-eabi] = "64"
EXTRA_IMAGE_FEATURES += "debug-tweaks tools-debug x11-base"
PACKAGE_DEBUG_SPLIT_STYLE = "debug-file-directory"
USER_CLASSES += "buildstats"

DEPLOY_DIR = "${TMPDIR}/../../deploy/${TCLIBC}"
# Don't generate the mirror tarball for SCM repos, the snapshot is enough
BB_GENERATE_MIRROR_TARBALLS = "0"

# Disable build time patch resolution. This would lauch a devshell
# and wait for manual intervention. We disable it.
PATCHRESOLVE = "noop"

#
# Shared-state files from other locations
#
# Shared state files are prebuilt cache data objects which can 
# used to accelerate build time. This variable can be used to configure the system
# to search other mirror locations for these objects before it builds the data itself.
#
# This can be a filesystem directory, or a remote url such as http or ftp. These
# would contain the sstate-cache results from previous builds (possibly from other 
# machines). This variable works like fetcher MIRRORS/PREMIRRORS and points to the 
# cache locations to check for the shared objects.
#SSTATE_MIRRORS ?= "\
#file://.* http://someserver.tld/share/sstate/ \n \
#file://.* file:///some/local/dir/sstate/"

#SSTATE_MIRRORS ?= "\
#file://.* http://dominion.thruhere.net/angstrom/sstate-mirror/ \n "

# enable PR service on build machine itself
# its good for a case when this is the only builder
# generating the feeds
#
PRSERV_HOST = "localhost:0"

PREMIRRORS:prepend = "\
     git://.*/.* https://downloads.trikset.com/mirror/downloads/ \n \
     ftp://.*/.* https://downloads.trikset.com/mirror/downloads/ \n \
     http://.*/.* https://downloads.trikset.com/mirror/downloads/ \n \
     https://.*/.* https://downloads.trikset.com/mirror/downloads/ \n"

TRIKOS_VERSION="2020.10"
TRIK_USER_PARTION_CREATION_DIR="/usr/share/trik/"
DISTRO_FEED_URI = "http://dl.trikset.com/distro/${TRIKOS_VERSION}/ipk/"
DISTRO_FEED_ARCHS = "all arm926ejse ${MACHINE_ARCH}"

MACHINE = "trikboard"
```
